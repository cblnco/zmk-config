## boards/shields/klink_kbd/Kconfig.defconfig
```kconfig
# Copyright (c) 2020 The ZMK Contributors
# SPDX-License-Identifier: MIT

if SHIELD_AGAR_MINI_BLE

config ZMK_KEYBOARD_NAME
    default "agar_mini_ble"

config LED
    default y

endif # SHIELD_AGAR_MINI_BLE
```
